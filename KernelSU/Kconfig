## KernelSU/Kconfig
```kconfig
menuconfig MULTI_KERNELSU
    bool "Enable Multi-Tree KernelSU Support"
    default y
    help
      Enables runtime cmdline switching between multiple KernelSU forks.

if MULTI_KERNELSU

config KSU_NEXT
    bool "Enable KernelSU-Next Tree"
    default y
    source "drivers/KernelSU/ksunext/Kconfig"

config KSU_RKSU
    bool "Enable rsuntk KernelSU (rksu) Tree"
    default y
    source "drivers/KernelSU/rksu/Kconfig"

config KSU_RESUKISU
    bool "Enable ReSukiSU Tree"
    default y
    source "drivers/KernelSU/resukisu/Kconfig"

config KSU_XXKSU
    bool "Enable backslashxx (xxksu) Tree"
    default y
    source "drivers/KernelSU/xxksu/Kconfig"

endif # MULTI_KERNELSU
```

## drivers/android/Kconfig
```kconfig
# SPDX-License-Identifier: GPL-2.0
menu "Android"

config ANDROID
	bool "Android Drivers"
	help
	  Enable support for various drivers needed on the Android platform

if ANDROID

config ANDROID_BINDER_IPC
	bool "Android Binder IPC Driver"
	depends on MMU
	default n
	help
	  Binder is used in Android for both communication between processes,
	  and remote method invocation.

	  This means one Android process can call a method/routine in another
	  Android process, using Binder to identify, invoke and pass arguments
	  between said processes.

config ANDROID_BINDERFS
	bool "Android Binderfs filesystem"
	depends on ANDROID_BINDER_IPC
	default n
	help
	  Binderfs is a pseudo-filesystem for the Android Binder IPC driver
	  which can be mounted per-ipc namespace allowing to run multiple
	  instances of Android.
	  Each binderfs mount initially only contains a binder-control device.
	  It can be used to dynamically allocate new binder IPC devices via
	  ioctls.

config ANDROID_BINDER_DEVICES
	string "Android Binder devices"
	depends on ANDROID_BINDER_IPC
	default "binder,hwbinder,vndbinder"
	help
	  Default value for the binder.devices parameter.

	  The binder.devices parameter is a comma-separated list of strings
	  that specifies the names of the binder device nodes that will be
	  created. Each binder device has its own context manager, and is
	  therefore logically separated from the other devices.

config ANDROID_BINDER_IPC_SELFTEST
	bool "Android Binder IPC Driver Selftest"
	depends on ANDROID_BINDER_IPC
	help
	  This feature allows binder selftest to run.

	  Binder selftest checks the allocation and free of binder buffers
	  exhaustively with combinations of various buffer sizes and
	  alignments.

config ANDROID_VENDOR_HOOKS
	bool "Android Vendor Hooks"
	depends on TRACEPOINTS
	help
	  Enable vendor hooks implemented as tracepoints

	  Allow vendor modules to attach to tracepoint "hooks" defined via
	  DECLARE_HOOK or DECLARE_RESTRICTED_HOOK.

config ANDROID_BINDER_LOGS
        bool "Android Binder Logging"
        depends on ANDROID_BINDERFS
        help
          Enables binder_logs directory in binderfs and debug_mask for dmesg
          logging. Needed for DEBUG_FS.
          This option impacts performance.

          Say N on production builds.

config ANDROID_TAGLMK
	bool "Android Task-aware Guided Low Memory Killer"
	depends on PROC_FS && MMU
	help
	  TAGLMK is an in-kernel low memory killer built for Android devices
	  with little memory, where the cost of a wrong decision is a cold start
	  of whatever the user was looking at.

	  It watches free swap and the active file cache, and reacts in two
	  stages.  While there is still swap to fill it only reclaims, walking
	  the address spaces of background tasks and pushing cold anonymous
	  pages into ZRAM so that nothing has to die.  Once swap is exhausted it
	  starts killing, and it picks its victims by how much CPU time each
	  application has accumulated: the one the user actually lives in has a
	  great deal and is killed last, the one they opened once and forgot
	  about has almost none and is killed first.

	  Tasks are sorted into four classes.  Android's own cores are never
	  candidates, system applications only become candidates once the file
	  cache has collapsed, and packages named through
	  /sys/kernel/mm/taglmk/pin survive longer than ordinary ones.

	  Tuning presets are selected from installed RAM at boot and every one
	  of them is adjustable at runtime under /sys/kernel/mm/taglmk.

	  Say N if userspace already runs its own low memory killer.

config ANDROID_TAGLMK_ARM64_NEON
	bool "TAGLMK ARM64 NEON accelerator"
	depends on ANDROID_TAGLMK && ARM64 && KERNEL_MODE_NEON
	default y
	help
	  Compute the load prediction and the ZRAM balancer's regression with
	  NEON instead of scalar code.  Every kernel is integer only and 64 bit
	  accumulated, so this changes how long a pass takes and nothing about
	  the decisions it reaches; the scalar path remains and is used whenever
	  the FPU cannot be touched from the calling context.

	  Say Y unless you are chasing a difference between the two paths.

endif # if ANDROID

endmenu
```

## drivers/android/taglmk/Kconfig
```kconfig
# SPDX-License-Identifier: GPL-2.0
config ANDROID_TAGLMK
	bool "Task-aware Android Guided Low Memory Killer (TAGLMK)"
	depends on ANDROID && MMU && SWAP
	help
	  TAGLMK is an independent, task-aware low-memory management driver for
	  Android.  Rather than only killing under pressure, it continuously
	  reclaims cold anonymous pages of background apps while free swap stays
	  above a configurable limit, and only begins killing once swap runs low.

	  Tasks are classified into CRITICAL, SYSTEM_APP, PINNED and APP phases.
	  Android system core processes are never killed.  App kills are biased
	  by cumulative CPU usage time so that lightly used apps are reclaimed
	  first and heavily used apps are preserved.  Packages may be pinned by
	  name to grant them materially longer survivability.

	  This is not simple_lmk and does not depend on it.  If unsure, say N.

config ANDROID_TAGLMK_ARM64_NEON
	bool "TAGLMK ARM64 NEON prediction accelerator"
	depends on ANDROID_TAGLMK && ARM64 && KERNEL_MODE_NEON
	default y
	help
	  Use an ARM64 NEON accelerator for TAGLMK's memory-cache-load and
	  burstiness prediction, computed in Q4.4 fixed point combined with an
	  integer/float (intfp) scalar factor.

	  When this option is disabled, or when NEON is unavailable at runtime,
	  TAGLMK falls back to an equivalent basic 32-bit integer/float
	  (intfp-32) implementation of the same algorithm.  The fallback yields
	  the same decisions; it is only slower.

	  If unsure, say Y.
```

## drivers/cpuidle/Kconfig
```kconfig
menu "CPU Idle"

config CPU_IDLE
	bool "CPU idle PM support"
	default y if ACPI || PPC_PSERIES
	help
	  CPU idle is a generic framework for supporting software-controlled
	  idle processor power management.  It includes modular cross-platform
	  governors that can be swapped during runtime.

	  If you're using an ACPI-enabled platform, you should say Y here.

if CPU_IDLE

config CPU_IDLE_MULTIPLE_DRIVERS
        bool

config CPU_IDLE_GOV_LADDER
	bool "Ladder governor (for periodic timer tick)"

config CPU_IDLE_GOV_MENU
	bool "Menu governor (for tickless system)"

config CPU_IDLE_GOV_NAP
	bool "Neural Adaptive Predictor (NAP) governor"
	depends on X86_64 || ARM64
	default n
	help
	  A machine-learning-based cpuidle governor that uses a small
	  neural network (MLP 8->8 trunk + ordinal survival head) to
	  predict the optimal idle state.  Weights are initialized from
	  hardware idle-state parameters and refined via online learning
	  (deferred backpropagation with SGD).

	  On x86_64 the whole network runs under kernel_fpu_begin() in the
	  governor's ->select() path (SSE2 at minimum, AVX2+FMA when the
	  CPU supports them).

	  On arm64 the ->select() path runs with interrupts disabled, where
	  kernel_neon_begin() is not usable, so inference is evaluated in
	  integer fixed-point (no FPU/NEON); the float backprop runs later
	  from ->reflect() using NEON, which is a mandatory AArch64 baseline.

	  This is experimental.  It registers with a higher rating than the
	  menu/ladder governors, so it becomes the active governor at boot
	  when built in; it can also be selected at runtime via
	  /sys/devices/system/cpu/cpuidle/current_governor.

	  If unsure, say N.

config DT_IDLE_STATES
	bool

menu "ARM CPU Idle Drivers"
depends on ARM || ARM64
source "drivers/cpuidle/Kconfig.arm"
endmenu

menu "MIPS CPU Idle Drivers"
depends on MIPS
source "drivers/cpuidle/Kconfig.mips"
endmenu

menu "POWERPC CPU Idle Drivers"
depends on PPC
source "drivers/cpuidle/Kconfig.powerpc"
endmenu

endif

config ARCH_NEEDS_CPU_IDLE_COUPLED
	def_bool n
endmenu
```

## drivers/gpu/msm/fld/Kconfig
```kconfig
# SPDX-License-Identifier: GPL-2.0-only

config FLD_GPU
	bool "FLD frame-load GPU scheduler for Adreno (KGSL)"
	depends on QCOM_KGSL=y
	help
	  Frame Load Decision (FLD) is a GPU scheduler for Qualcomm Adreno
	  (KGSL) that picks GPU power levels from per-frame demand instead
	  of only reacting to averaged GPU busy time.  It combines GPU
	  feedback (hardware busy counters) with CPU feed-forward (PELT
	  utilization of the threads submitting GPU work), then tunes the
	  latency-adding parts of the KGSL power path (idle timer, power
	  level shaping) on top.

	  FLD is NOT a devfreq governor: there is nothing to select.  While
	  FLD is enabled it owns the GPU frequency decision and the stock
	  devfreq governor's requests are ignored; all thermal and user
	  constraints keep working.  /sys/kernel/fld/ exposes tunables and
	  runtime status.

	  Requires CONFIG_QCOM_KGSL=y (built-in).  Verified on Linux 4.19
	  (Adreno 610 / Snapdragon 680).  See docs/fld-kgsl-hooks.md for the
	  KGSL integration points this depends on.

config FLD_GPU_DEBUG
	bool "FLD verbose decision logging"
	depends on FLD_GPU
	help
	  Log every FLD frequency decision and idle-timer change with
	  pr_info_ratelimited().  Off by default; enable only while tuning,
	  this can be noisy under sustained GPU load.
```

## drivers/input/touchscreen/xiaomi/Kconfig
```kconfig
config TOUCHSCREEN_XIAOMI_TOUCHFEATURE
	bool "Xiaomi Touch Feature"
	depends on INPUT_TOUCHSCREEN
	help
	  Say Y here to enable the xiaomi touchfeature core: it provides the
	  /dev/xiaomi-touch misc device, the "touch" class that touchscreen
	  drivers hang their tp_dev child off, and the mode ioctl used by the
	  vendor userspace to toggle features such as double tap to wake.

	  This has to be built in rather than as a module: the touchscreen
	  drivers that call into it are boolean and are linked into vmlinux.

	  If unsure, say N.
```
